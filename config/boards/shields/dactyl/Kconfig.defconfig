## config/boards/shields/dactyl/Kconfig.defconfig
```kconfig
if SHIELD_DACTYL_LEFT

    config ZMK_KEYBOARD_NAME
        default "DM-BF(Left)"

    config ZMK_SPLIT_BLE_ROLE_CENTRAL
        default y

endif


if SHIELD_DACTYL_LEFT || SHIELD_DACTYL_RIGHT

    config ZMK_SPLIT
        default y

endif
```

## config/boards/shields/dactyl/Kconfig.shield
```kconfig
config SHIELD_DACTYL_LEFT
    def_bool $(shields_list_contains,dactyl_left)

config SHIELD_DACTYL_MANUFORM_5x6_RIGHT
    def_bool $(shields_list_contains,dactyl_right)
```
